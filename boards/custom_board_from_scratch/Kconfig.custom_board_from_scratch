## boards/custom_board_from_scratch/Kconfig.custom_board_from_scratch
```kconfig
# Copyright (c) 2016 Linaro Limited.
# SPDX-License-Identifier: Apache-2.0

config BOARD_CUSTOM_BOARD_FROM_SCRATCH
	select SOC_STM32F407XG
```

## boards/custom_board_from_scratch/board.yml
```yaml
board:
  name: custom_board_from_scratch
  full_name: My Custom Board from Scratch
  vendor: IOMICO
  socs:
    - name: stm32f407xx
```

## boards/my_custom_board/board.yml
```yaml
board:
  name: my_custom_board
  full_name: My Custom Board
  vendor: IOMICO
  socs:
    - name: stm32f407xx
```
